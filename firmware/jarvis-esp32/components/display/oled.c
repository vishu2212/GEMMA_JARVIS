#include "oled.h"
#include "freertos/FreeRTOS.h"
#include "freertos/task.h"
#include "esp_log.h"
#include <string.h>

static const char* TAG = "SH1106";

// 5x7 ASCII font (characters 32–126)
static const uint8_t font5x7[][5] = {
    {0x00, 0x00, 0x00, 0x00, 0x00}, // 32: Space
    {0x00, 0x00, 0x5f, 0x00, 0x00}, // 33: !
    {0x00, 0x07, 0x00, 0x07, 0x00}, // 34: "
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    {0x10, 0x08, 0x08, 0x10, 0x08}, // 126: ~
};

// SH1106 initialization sequence
static const uint8_t sh1106_init_cmds[] = {
    0xAE,       // Display OFF
    0xD5, 0x80, // Set display clock divide ratio
    0xA8, 0x3F, // Set multiplex ratio to 64
    0xD3, 0x00, // Set display offset to 0
    0x40,       // Set display start line to 0
    0xAD, 0x8B, // Set DC-DC ON (SH1106-specific: internal charge pump)
    0x32,       // Set pump voltage to 8.0V
    0xA1,       // Set segment re-map (column 127 = SEG0)
    0xC8,       // Set COM output scan direction (remapped)
    0xDA, 0x12, // Set COM pins hardware configuration
    0x81, 0xBF, // Set contrast to 0xBF
    0xD9, 0x22, // Set pre-charge period
    0xDB, 0x40, // Set VCOMH deselect level
    0xA4,       // Entire display ON (resume from RAM)
    0xA6,       // Set normal display (not inverted)
    0xAF,       // Display ON
};

static esp_err_t write_cmd(oled_display_t* dev, uint8_t cmd)
{
    uint8_t buf[2] = { 0x00, cmd }; // Co=0, D/C#=0 (command)
    return i2c_master_transmit(dev->dev_handle, buf, 2, 100);
}

esp_err_t oled_init(oled_display_t* dev, int sda_io, int scl_io, uint8_t address)
{
    if (!dev) return ESP_ERR_INVALID_ARG;
    if (dev->initialized) return ESP_OK;

    memset(dev->buffer, 0, sizeof(dev->buffer));

    ESP_LOGI(TAG, "Initializing I2C master bus (SDA=%d, SCL=%d)...", sda_io, scl_io);

    // 1. Create I2C master bus
    i2c_master_bus_config_t bus_config = {
        .i2c_port = I2C_NUM_0,
        .sda_io_num = sda_io,
        .scl_io_num = scl_io,
        .clk_source = I2C_CLK_SRC_DEFAULT,
        .glitch_ignore_cnt = 7,
        .flags.enable_internal_pullup = true,
    };

    esp_err_t ret = i2c_new_master_bus(&bus_config, &dev->bus_handle);
    if (ret != ESP_OK) {
        ESP_LOGE(TAG, "Failed to create I2C bus: %s", esp_err_to_name(ret));
        return ret;
    }

    // 2. Add SH1106 device on the bus
    i2c_device_config_t dev_config = {
        .dev_addr_length = I2C_ADDR_BIT_LEN_7,
        .device_address = address,
        .scl_speed_hz = 400000,
    };

    ret = i2c_master_bus_add_device(dev->bus_handle, &dev_config, &dev->dev_handle);
    if (ret != ESP_OK) {
        ESP_LOGE(TAG, "Failed to add I2C device: %s", esp_err_to_name(ret));
        i2c_del_master_bus(dev->bus_handle);
        return ret;
    }

    // 3. Send SH1106 init commands
    ESP_LOGI(TAG, "Sending SH1106 initialization commands...");
    for (size_t i = 0; i < sizeof(sh1106_init_cmds); i++) {
        ret = write_cmd(dev, sh1106_init_cmds[i]);
        if (ret != ESP_OK) {
            ESP_LOGE(TAG, "Failed sending init cmd 0x%02X: %s", sh1106_init_cmds[i], esp_err_to_name(ret));
            return ret;
        }
    }

    dev->initialized = true;
    oled_clear(dev);
    oled_refresh(dev);
    ESP_LOGI(TAG, "SH1106 OLED Display initialized successfully.");
    return ESP_OK;
}

void oled_clear(oled_display_t* dev)
{
    if (!dev) return;
    memset(dev->buffer, 0, sizeof(dev->buffer));
}

esp_err_t oled_refresh(oled_display_t* dev)
{
    if (!dev || !dev->initialized) return ESP_ERR_INVALID_STATE;

    // SH1106 uses page addressing mode.
    // Each page is 128 columns, but SH1106 has 132 columns internally.
    // The visible 128 columns start at column offset 2.
    for (int page = 0; page < 8; page++) {
        // Set page address
        write_cmd(dev, 0xB0 | page);
        // Set lower column address (offset 2 = 0x02)
        write_cmd(dev, 0x02);
        // Set higher column address (0x10)
        write_cmd(dev, 0x10);

        // Send 128 bytes of pixel data for this page
        // Prepend 0x40 control byte (Co=0, D/C#=1 = data)
        uint8_t data_buf[129];
        data_buf[0] = 0x40;
        memcpy(&data_buf[1], &dev->buffer[page * 128], 128);

        esp_err_t ret = i2c_master_transmit(dev->dev_handle, data_buf, 129, 500);
        if (ret != ESP_OK) {
            ESP_LOGE(TAG, "Failed to refresh page %d: %s", page, esp_err_to_name(ret));
            return ret;
        }
    }
    return ESP_OK;
}

void oled_draw_pixel(oled_display_t* dev, int x, int y, bool color)
{
    if (!dev || x < 0 || x >= 128 || y < 0 || y >= 64) return;

    int page = y / 8;
    int bit = y % 8;
    int index = page * 128 + x;

    if (color) {
        dev->buffer[index] |= (1 << bit);
    } else {
        dev->buffer[index] &= ~(1 << bit);
    }
}

void oled_print_char(oled_display_t* dev, int x, int page, char c)
{
    if (!dev || !dev->initialized || page < 0 || page > 7 || x < 0 || x >= 128) return;

    if (c < 32 || c > 126) {
        c = ' ';
    }

    int font_idx = c - 32;
    for (int col = 0; col < 5; col++) {
        if (x + col >= 128) break;
        dev->buffer[page * 128 + (x + col)] = font5x7[font_idx][col];
    }

    // 1 pixel gap between characters
    if (x + 5 < 128) {
        dev->buffer[page * 128 + (x + 5)] = 0x00;
    }
}

void oled_print_string(oled_display_t* dev, int x, int page, const char* str)
{
    if (!dev || !dev->initialized || !str) return;

    int cur_x = x;
    while (*str) {
        oled_print_char(dev, cur_x, page, *str);
        cur_x += 6;
        if (cur_x >= 128) break;
        str++;
    }
}

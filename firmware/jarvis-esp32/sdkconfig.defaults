## firmware/jarvis-esp32/sdkconfig.defaults
```kconfig
# Target Chip
CONFIG_IDF_TARGET="esp32s3"

# Flash Size (16MB detected on board)
CONFIG_ESPTOOLPY_FLASHSIZE_16MB=y

# ESP32-S3 PSRAM (SPIRAM) Configurations
CONFIG_ESP32S3_SPIRAM_SUPPORT=y
CONFIG_SPIRAM_MODE_OCT=y
CONFIG_SPIRAM_TYPE_AUTO=y
CONFIG_SPIRAM=y
CONFIG_SPIRAM_BOOT_INIT=y
CONFIG_SPIRAM_USE_MALLOC=y

# FreeRTOS clock config
CONFIG_FREERTOS_HZ=1000
```
